/******************************************************************************

                  版权所有 (C), 1994-2016, 杭州九阳欧南多小家电有限公司

 ******************************************************************************
  文 件 名   : Pos.c
  版 本 号   : V1.0
  作    者   : tht
  生成日期   : 2016年12月22日
  最近修改   :
  功能描述   : 位置坐标计算
  函数列表   :
  修改历史   :
  1.日    期   : 2016年12月22日
    作    者   : tht
    修改内容   : 创建文件

******************************************************************************/

/*----------------------------------------------*
 * 包含头文件                                   *
 *----------------------------------------------*/
#include "stm32f10x.h"

/*----------------------------------------------*
 * 外部变量说明                                 *
 *----------------------------------------------*/

/*----------------------------------------------*
 * 外部函数原型说明                             *
 *----------------------------------------------*/

/*----------------------------------------------*
 * 内部函数原型说明                             *
 *----------------------------------------------*/

/*----------------------------------------------*
 * 全局变量                                     *
 *----------------------------------------------*/
//int32_t Motion_Angle;
pos_t Motion_Pos;

/*----------------------------------------------*
 * 模块级变量                                   *
 *----------------------------------------------*/

/*----------------------------------------------*
 * 常量定义                                     *
 *----------------------------------------------*/
// 0~90度，每隔0.01度的正弦值 ，系数32768
const uint16_t DSIN_TABLE[9001] = 
{	
	0,	6,	11, 17, 23, 29, 34, 40, 46, 51, 57, 63,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	566,
	
	572,	578,	583,	589,	595,	600,	606,	612,	618,	623,	629,	635,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	1138,
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	32763,	32763,	32763,	32763,	32763,	32763,	32764,	32764,	32764,	32764,	32764,	32764,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	32768,
	
	32768
};


/*----------------------------------------------*
 * 宏定义                                       *
 *----------------------------------------------*/
//#define ROBOT_WHEEL_PERIMETER				20954 //0.01mm
//#define ROBOT_WHEEL_PER_LAP_PULSE_COUNT		986
//#define ROBOT_WHEEL_AXIS					275 // mm

#define DSIN(x) (DSIN_TABLE[(x)])

int32_t MF_DSIN(int16_t x)
{
	int32_t tmpdata;
	if(x >= 0 && x <= 9000)
        tmpdata = DSIN(x);
    else if(x > 9000 && x <= 18000)
        tmpdata = DSIN(18000 - x);
	else if(x < 0 && x > -9000)
		tmpdata = -DSIN(-x);
	else if(x >= -18000 && x <= -9000)
		tmpdata = -DSIN(x + 18000);

	return tmpdata;

}

int32_t MF_DCOS(int16_t x)
{
	int32_t tmpdata;
   	if( x >= 0 && x <= 9000)
        tmpdata = DSIN(9000 - x);
   	else if(x < 0 && x >= -9000)
        tmpdata = DSIN(x + 9000);
	else if(x < -9000 && x >= -18000)
		tmpdata = -DSIN(- x - 9000);
	else if(x > 9000 && x <= 18000)
		tmpdata = -DSIN(x - 9000);
	return tmpdata;
}



void pos_calc ( pos_t * pos , int16_t inc_left , int16_t inc_right , int16_t inc_angle)
{
   	static uint16_t per_pulse_distance = ROBOT_WHEEL_PERIMETER / ROBOT_WHEEL_PER_LAP_PULSE_COUNT ;
//   	static uint16_t axis = ROBOT_WHEEL_AXIS ;
   
   	int32_t Si , So , L , R;
   	int16_t Alpha , Theta ;
//	uint32_t L;
   
   	/* calc the distance of wheels */
   	So = inc_right * per_pulse_distance ;
   	Si = inc_left  * per_pulse_distance ;
	Alpha = 0 - inc_angle;
    
   
   	if ( Alpha < 2)
   	{
//	 	Alpha = 0 ;
	 	L = (So + Si) >> 1 ;
   	}
   	else
   	{
	 	/* calc the Alpha & L */
//	 	Alpha = (So - Si) / axis ;
	 	R = ((So + Si) << 14)/ MF_DSIN(Alpha) ;
	 	L = (MF_DSIN(Alpha / 2) * R) >> 14 ;
   	}

   	/* calc the delta */
   	Theta = pos->theta ;
   	pos->y += ((MF_DCOS (Theta) * L) >> 15) ;
   	pos->x += ((MF_DSIN (Theta) * L) >> 15) ;
 //  	pos ->theta += Alpha ;
   
	/* format theta */
//	pos ->theta = angle_format(pos ->theta) ;
}

void motion_updata_pos(void)
{
	int16_t LeftPlusInc, RightPlusInc;
    int32_t AngleInc;
//	if(!RobitStatus)
//		return;
	
	if(LeftMileageAllPre == LeftMileageAll && RightMileageAll == RightMileageAllPre)
		return;

	if(!GyroDataVlid)
		return;
	GyroDataVlid = DISABLE;

	LeftPlusInc = LeftMileageAll - LeftMileageAllPre;
	RightPlusInc = RightMileageAll - RightMileageAllPre;
	AngleInc = Sys_Angle - Sys_AnglePre;
    
    //限定角度差范围在(-180~+180)
    if(AngleInc > 18000)
    {
        AngleInc -= 36000;
    }
    else if(AngleInc < -18000)
    {
        AngleInc += 36000;
    }
    
	Sys_AnglePre = Sys_Angle;
	LeftMileageAllPre = LeftMileageAll;
	RightMileageAllPre = RightMileageAll;

	pos_calc(&Motion_Pos, LeftPlusInc, RightPlusInc, (int16_t)AngleInc);
	
}

void motion_init(void)
{
	Motion_Pos.theta = 0;
	Motion_Pos.x = 0;
	Motion_Pos.y = 0;
}

